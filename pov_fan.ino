// 3D Holographic (POV) Fan - Arduino Uno starter firmware
// Drives 8 LEDs on a rotating blade. Replace with your final project code
// if it differs; this is a clean template matching the hardware list in /hardware.
#include "frame.h"   // generated by software/image_to_pov.py

#define USE_HALL 0   // set to 1 if you add a Hall/optical sensor on D2

const uint8_t LED_PINS[8] = {4, 5, 6, 7, 8, 9, 10, 11};
const uint8_t POT_PIN  = A0;   // calibration pot (column time)
const uint8_t HALL_PIN = 2;    // optional, interrupt 0

volatile unsigned long lastRev = 0, revTime = 0;
volatile bool newRev = false;

void onHall() {
  unsigned long now = micros();
  revTime = now - lastRev;
  lastRev = now;
  newRev = true;
}

void showColumn(uint8_t bits) {
  for (uint8_t i = 0; i < 8; i++) digitalWrite(LED_PINS[i], (bits >> i) & 1);
}

void setup() {
  for (uint8_t i = 0; i < 8; i++) pinMode(LED_PINS[i], OUTPUT);
#if USE_HALL
  pinMode(HALL_PIN, INPUT_PULLUP);
  attachInterrupt(digitalPinToInterrupt(HALL_PIN), onHall, FALLING);
#endif
}

void loop() {
  unsigned long colUs;
#if USE_HALL
  while (!newRev) {}                 // wait for start of revolution
  noInterrupts(); newRev = false; unsigned long rt = revTime; interrupts();
  colUs = rt / NUM_COLUMNS;
#else
  colUs = map(analogRead(POT_PIN), 0, 1023, 20, 300);  // tune by hand
#endif
  for (uint16_t c = 0; c < NUM_COLUMNS; c++) {
    showColumn(pgm_read_byte(&FRAME[c]));
    delayMicroseconds(colUs);
  }
  showColumn(0);
}
